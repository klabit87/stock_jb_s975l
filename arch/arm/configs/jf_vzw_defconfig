## arch/arm/configs/jf_vzw_defconfig
```kconfig
CONFIG_MACH_JF_VZW=y
CONFIG_EXTRA_FIRMWARE="audience-es325-fw-vzw.bin"
CONFIG_EXTRA_FIRMWARE_DIR="firmware"
CONFIG_AUTHENTEC_VPNCLIENT_INTERCEPTOR=y
#VMWARE RELATED
CONFIG_VMWARE_MVP=y

#change@ksingh.sra-dallas - start
CONFIG_CRYPTO_TEST=y
CONFIG_CRYPTO_FIPS_INTEG_COPY_ADDRESS=0x8A008000
CONFIG_CRYPTO_MANAGER_DISABLE_TESTS=n
CONFIG_CRYPTO_ANSI_CPRNG=y
CONFIG_CRYPTO_FIPS=y
CONFIG_CRYPTO_SHA512=y
#change@ksingh.sra-dallas - end
```
